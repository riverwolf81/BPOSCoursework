## package/filebrowser/Config.in
```kconfig
config BR2_PACKAGE_FILEBROWSER
    bool "filebrowser"
    help
      Lightweight web-based file manager for ARM.
      From: https://github.com/filebrowser/filebrowser/releases
```

## package/filemgr/Config.in
```kconfig
config BR2_PACKAGE_FILEMGR
    bool "filemgr"
    depends on BR2_USE_WCHAR
    depends on BR2_PACKAGE_SDL2
    depends on BR2_PACKAGE_SDL2_TTF
    help
      A simple file manager using SDL2 and SDL2_ttf for font rendering.
```

## package/filemgr_web/Config.in
```kconfig
config BR2_PACKAGE_FILEMGR_WEB
    bool "filemgr_web"
    help
      Python-based web file manager with icons and keyboard navigation.
```
